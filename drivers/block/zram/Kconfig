## drivers/block/zram/Kconfig
```kconfig
# SPDX-License-Identifier: GPL-2.0
config ZRAM
	tristate "Compressed RAM block device support"
	depends on BLOCK && SYSFS && ZSMALLOC && CRYPTO
	select CRYPTO_LZO
	help
	  Creates virtual block devices called /dev/zramX (X = 0, 1, ...).
	  Pages written to these disks are compressed and stored in memory
	  itself. These disks allow very fast I/O and compression provides
	  good amounts of memory savings.

	  It has several use cases, for example: /tmp storage, use as swap
	  disks and maybe many more.

	  See Documentation/admin-guide/blockdev/zram.rst for more information.

choice
	prompt "Default compression algorithm"
	depends on ZRAM
	default ZRAM_DEF_COMP_LZO_RLE
	help
	  Select the compression algorithm used by zram by default.
	  The chosen algorithm must also be built (see CRYPTO_* options).
	  lzo-rle is the safe default; old defconfigs that predate these
	  options therefore fall back to lzo-rle at config time.

config ZRAM_DEF_COMP_LZO_RLE
	bool "lzo-rle"
	help
	  LZO-RLE compression (the historical default).

config ZRAM_DEF_COMP_LZ4KD
	bool "lz4kd"
	select CRYPTO_LZ4KD
	help
	  Huawei LZ4KD compression.

config ZRAM_DEF_COMP_LZ4KDR
	bool "lz4kdr"
	select CRYPTO_LZ4KDR
	help
	  LZ4KDR, a speed-tuned derivative of LZ4KD.

endchoice

config ZRAM_DEF_COMP
	string
	depends on ZRAM
	default "lzo-rle" if ZRAM_DEF_COMP_LZO_RLE
	default "lz4kd" if ZRAM_DEF_COMP_LZ4KD
	default "lz4kdr" if ZRAM_DEF_COMP_LZ4KDR
	default "lzo-rle"
	help
	  The selected default compressor name, consumed by the zram driver.
	  Falls back to "lzo-rle" if no ZRAM_DEF_COMP_* option is selected
	  (e.g. an older defconfig that predates these options).

config ZRAM_WRITEBACK
       bool "Write back incompressible or idle page to backing device"
       depends on ZRAM
       help
	 With incompressible page, there is no memory saving to keep it
	 in memory. Instead, write it out to backing device.
	 For this feature, admin should set up backing device via
	 /sys/block/zramX/backing_dev.

	 With /sys/block/zramX/{idle,writeback}, application could ask
	 idle page's writeback to the backing device to save in memory.

	 See Documentation/admin-guide/blockdev/zram.rst for more information.

config ZRAM_MEMORY_TRACKING
	bool "Track zRam block status"
	depends on ZRAM && DEBUG_FS
	help
	  With this feature, admin can track the state of allocated blocks
	  of zRAM. Admin could see the information via
	  /sys/kernel/debug/zram/zramX/block_state.

	  See Documentation/admin-guide/blockdev/zram.rst for more information.

config ZRAM_MULTI_COMP
	bool "Enable multiple compression streams"
	depends on ZRAM
	help
	  This will enable multi-compression streams, so that ZRAM can
	  re-compress pages using a potentially slower but more effective
	  compression algorithm. Note, that IDLE page recompression
	  requires ZRAM_MEMORY_TRACKING.
```
